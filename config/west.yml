## config/west.yml
```yaml
manifest:
  defaults:
    revision: v0.3
  remotes:
    - name: zmkfirmware
      url-base: https://github.com/zmkfirmware
    - name: tomicodev
      url-base: https://github.com/Tomico-DEV
  projects:
    - name: zmk
      remote: zmkfirmware
      import: app/west.yml
    - name: zmk-keyboard-m65legorev9
      remote: tomicodev
      revision: master
    - name: zmk-driver-m65legorev9
      remote: tomicodev
      revision: master
  self:
    path: config
```
